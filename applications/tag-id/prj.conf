## CMakeLists.txt
```
cmake_minimum_required(VERSION 3.20.0)

find_package(Zephyr REQUIRED HINTS $ENV{ZEPHYR_BASE})
project(tag_id LANGUAGES C)

target_sources(app PRIVATE
	src/main.c
	${CMAKE_CURRENT_SOURCE_DIR}/../../lib/juxta_id/src/juxta_id.c
)
target_include_directories(app PRIVATE
	${CMAKE_CURRENT_SOURCE_DIR}/../../lib/juxta_id/include
)
```

## Kconfig
```
# If this file exists, CMake sets KCONFIG_ROOT to it — include Zephyr first.
mainmenu "Zephyr Kernel Configuration"

source "${ZEPHYR_BASE}/Kconfig.zephyr"

menu "Juxta tag-id"

config JUXTA_PROFILE_MOBILE
	bool "Compile as mobile profile"
	default y
	help
	  HIL identity fixture: log configured profile as mobile.
	  Anchor profile Kconfig is deferred.

endmenu
```

## sample.yaml
```
sample:
  name: Tag Identity
  description: >
    HIL: log hwinfo device ID, BLE identity address, JX_XXXXXX name, and
    mobile profile. LED1 green brief on boot.

common:
  tags:
    - tag
    - bringup
    - identity

tests:
  applications.tag-id:
    platform_allow:
      - nrf54l15tag/nrf54l15/cpuapp
    harness: console
```

## prj.conf
```kconfig
# HIL: unique device identity + mobile profile
CONFIG_GPIO=y
CONFIG_HWINFO=y

CONFIG_BT=y
CONFIG_BT_PERIPHERAL=y
CONFIG_BT_DEVICE_NAME="JX_TAG"
CONFIG_BT_MAX_CONN=1

CONFIG_JUXTA_PROFILE_MOBILE=y

CONFIG_LOG=y
CONFIG_LOG_DEFAULT_LEVEL=3
CONFIG_BT_HCI_CORE_LOG_LEVEL_WRN=y
CONFIG_LOG_BUFFER_SIZE=4096

CONFIG_MAIN_STACK_SIZE=4096
```

## src/main.c
```c
/*
 * HIL: unique device identity + mobile profile (no NVS / policy machinery).
 */

#include <stdio.h>
#include <string.h>

#include <zephyr/bluetooth/bluetooth.h>
#include <zephyr/device.h>
#include <zephyr/devicetree.h>
#include <zephyr/drivers/gpio.h>
#include <zephyr/drivers/hwinfo.h>
#include <zephyr/kernel.h>
#include <zephyr/logging/log.h>
#include <zephyr/sys/byteorder.h>

#include "juxta_id.h"

LOG_MODULE_REGISTER(tag_id, LOG_LEVEL_INF);

#define BOOT_LED_MS 500U

#if !DT_NODE_EXISTS(DT_NODELABEL(led1_green))
#error "Board must define led1_green"
#endif

static const struct gpio_dt_spec led_g = GPIO_DT_SPEC_GET(DT_NODELABEL(led1_green), gpios);

static void log_hwinfo_id(void)
{
	uint8_t buf[16];
	ssize_t len;
	char hex[33];

	memset(buf, 0, sizeof(buf));
	len = hwinfo_get_device_id(buf, sizeof(buf));
	if (len < 0) {
		LOG_WRN("hwinfo_get_device_id failed (%d)", (int)len);
		return;
	}

	size_t n = (size_t)len;

	if (n > 16U) {
		n = 16U;
	}
	for (size_t i = 0; i < n; i++) {
		(void)snprintf(&hex[i * 2U], 3, "%02x", buf[i]);
	}
	hex[n * 2U] = '\0';
	LOG_INF("hwinfo_device_id len=%d hex=%s", (int)len, hex);
}

static void log_bt_addrs(void)
{
	bt_addr_le_t addrs[CONFIG_BT_ID_MAX];
	size_t count = ARRAY_SIZE(addrs);
	char addr_str[BT_ADDR_LE_STR_LEN];

	bt_id_get(addrs, &count);
	LOG_INF("bt_id count=%u", (unsigned int)count);
	for (size_t i = 0; i < count; i++) {
		bt_addr_le_to_str(&addrs[i], addr_str, sizeof(addr_str));
		LOG_INF("bt_id[%u]=%s", (unsigned int)i, addr_str);
	}
}

int main(void)
{
	char jx_name[JUXTA_ID_LEN];
	int err;

	if (!gpio_is_ready_dt(&led_g)) {
		LOG_ERR("led1_green not ready");
		return -ENODEV;
	}

	err = gpio_pin_configure_dt(&led_g, GPIO_OUTPUT_INACTIVE);
	if (err != 0) {
		LOG_ERR("led1_green configure failed (%d)", err);
		return err;
	}

	(void)gpio_pin_set_dt(&led_g, 1);

	LOG_INF("tag-id started");
	log_hwinfo_id();

	err = bt_enable(NULL);
	if (err != 0) {
		LOG_ERR("bt_enable failed (%d)", err);
		return err;
	}

	/* Let HCI boot logs drain so HIL identity lines are not dropped on RTT. */
	k_sleep(K_MSEC(50));

	log_bt_addrs();

	err = juxta_id_fill_from_bt(jx_name, sizeof(jx_name));
	if (err != 0) {
		LOG_ERR("juxta_id_fill_from_bt failed (%d)", err);
		return err;
	}

	LOG_INF("juxta_name=%s", jx_name);
#if IS_ENABLED(CONFIG_JUXTA_PROFILE_MOBILE)
	LOG_INF("juxta_profile=mobile");
#else
	LOG_INF("juxta_profile=unknown");
#endif

	k_sleep(K_MSEC(BOOT_LED_MS));
	(void)gpio_pin_set_dt(&led_g, 0);

	LOG_INF("tag-id done (idle) juxta_name=%s", jx_name);
	while (1) {
		k_sleep(K_SECONDS(60));
	}

	return 0;
}
```
