## CMakeLists.txt
```
cmake_minimum_required(VERSION 3.20.0)

find_package(Zephyr REQUIRED HINTS $ENV{ZEPHYR_BASE})
project(tag_vdd LANGUAGES C)

target_sources(app PRIVATE
	src/main.c
	${CMAKE_CURRENT_SOURCE_DIR}/../../lib/juxta_vdd/src/juxta_vdd.c
)
target_include_directories(app PRIVATE
	${CMAKE_CURRENT_SOURCE_DIR}/../../lib/juxta_vdd/include
)
```

## sample.yaml
```
sample:
  name: Tag VDD Battery
  description: >
    HIL: SAADC internal VDD (CR2032). Logs vdd_mv and rough batt_pct; optional adv droop.

common:
  tags:
    - tag
    - bringup
    - adc

tests:
  applications.tag-vdd:
    platform_allow:
      - nrf54l15tag/nrf54l15/cpuapp
    harness: console
```

## prj.conf
```kconfig
# HIL: SAADC internal VDD (CR2032 / direct supply). No FUEL divider on Tag.
CONFIG_GPIO=y
CONFIG_ADC=y

CONFIG_BT=y
CONFIG_BT_BROADCASTER=y
CONFIG_BT_DEVICE_NAME="JX_VDD"

CONFIG_LOG=y
CONFIG_LOG_DEFAULT_LEVEL=3

CONFIG_MAIN_STACK_SIZE=4096
```

## boards/nrf54l15tag_nrf54l15_cpuapp.overlay
```dts
/*
 * tag-vdd: measure internal VDD via SAADC (coin-cell / direct supply).
 * Match Nordic nrf54l15tag fuel-gauge overlay: GAIN_1_4 + 0.9 V internal
 * reference + 14-bit (NRF_SAADC_VDD is scaled; GAIN_1 reads ~VDD/4).
 */

/ {
	zephyr,user {
		io-channels = <&adc 0>;
	};
};

&adc {
	#address-cells = <1>;
	#size-cells = <0>;
	status = "okay";

	channel@0 {
		reg = <0>;
		zephyr,gain = "ADC_GAIN_1_4";
		zephyr,reference = "ADC_REF_INTERNAL";
		zephyr,acquisition-time = <ADC_ACQ_TIME_DEFAULT>;
		zephyr,resolution = <14>;
		zephyr,oversampling = <8>;
		zephyr,vref-mv = <900>;
		zephyr,input-positive = <NRF_SAADC_VDD>;
	};
};
```

## src/main.c
```c
/*
 * HIL: SAADC internal VDD measurement (CR2032 characterization).
 * Samples idle, then after a short non-connectable adv burst (TX droop check).
 */

#include <zephyr/bluetooth/bluetooth.h>
#include <zephyr/kernel.h>
#include <zephyr/logging/log.h>

#include "juxta_vdd.h"

LOG_MODULE_REGISTER(tag_vdd, LOG_LEVEL_INF);

#define IDLE_SAMPLES 5U
#define POST_ADV_SAMPLES 3U

static const struct bt_data ad[] = {
	BT_DATA_BYTES(BT_DATA_FLAGS, BT_LE_AD_NO_BREDR),
	BT_DATA(BT_DATA_NAME_COMPLETE, CONFIG_BT_DEVICE_NAME, sizeof(CONFIG_BT_DEVICE_NAME) - 1),
};

static void log_sample(const char *tag)
{
	int32_t mv = juxta_vdd_read_mv();

	if (mv < 0) {
		LOG_WRN("%s vdd_read failed (%d)", tag, (int)mv);
		return;
	}

	LOG_INF("%s vdd_mv=%d batt_pct~%u (CR2032 estimate)", tag, (int)mv,
		juxta_vdd_mv_to_percent_cr2032(mv));
}

int main(void)
{
	int err;

	LOG_INF("tag-vdd started (SAADC NRF_SAADC_VDD)");

	err = juxta_vdd_init();
	if (err) {
		LOG_ERR("juxta_vdd_init (%d)", err);
		return err;
	}

	err = bt_enable(NULL);
	if (err) {
		LOG_ERR("bt_enable (%d)", err);
		return err;
	}

	for (uint32_t i = 0; i < IDLE_SAMPLES; i++) {
		log_sample("idle");
		k_sleep(K_SECONDS(1));
	}

	err = bt_le_adv_start(BT_LE_ADV_NCONN_IDENTITY, ad, ARRAY_SIZE(ad), NULL, 0);
	if (err) {
		LOG_WRN("adv start (%d) — continuing without TX droop check", err);
	} else {
		LOG_INF("Advertising 3 s for TX droop sample");
		k_sleep(K_SECONDS(3));
		for (uint32_t i = 0; i < POST_ADV_SAMPLES; i++) {
			log_sample("adv");
			k_sleep(K_MSEC(500));
		}
		(void)bt_le_adv_stop();
	}

	while (1) {
		log_sample("idle");
		k_sleep(K_SECONDS(2));
	}

	return 0;
}
```
